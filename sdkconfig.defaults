## sdkconfig.defaults
```kconfig
CONFIG_ATECC608A_TCUSTOM=y
CONFIG_ATCA_MBEDTLS_ECDSA=y
CONFIG_ATCA_MBEDTLS_ECDSA_SIGN=y
CONFIG_ATCA_MBEDTLS_ECDSA_VERIFY=y
CONFIG_BT_ENABLED=y
CONFIG_BT_BLUEDROID_ENABLED=y
CONFIG_BT_BTC_TASK_STACK_SIZE=8192
CONFIG_BTC_TASK_STACK_SIZE=8192
```
